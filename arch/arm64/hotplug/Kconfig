## arch/arm64/hotplug/Kconfig
```kconfig
config THUNDERPLUG_CONTROL
	bool "Enable plugging down/up of cores using powersuspend"
	default y
	help
	  This driver uses powersuspend to take down the cpu cores
	  on a octa core device.
```
